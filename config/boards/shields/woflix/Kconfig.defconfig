## config/boards/shields/woflix/Kconfig.defconfig
```kconfig
if SHIELD_WOFLIX_LEFT

config ZMK_KEYBOARD_NAME
	default "Woflix"

config ZMK_SPLIT_BLE_ROLE_CENTRAL
	default y

endif


if SHIELD_WOFLIX_RIGHT

#config ZMK_KEYBOARD_NAME
#	default "Woflix (Right)"

#config USB
#	default y

endif

if SHIELD_WOFLIX_LEFT || SHIELD_WOFLIX_RIGHT

config ZMK_SPLIT
	default y

endif
```

## config/boards/shields/woflix/Kconfig.shield
```kconfig
# Copyright (c) 2020 Pete Johanson
# SPDX-License-Identifier: MIT

config SHIELD_WOFLIX_LEFT
	def_bool $(shields_list_contains,woflix_left)

config SHIELD_WOFLIX_RIGHT
	def_bool $(shields_list_contains,woflix_right)
```
